## CMakeLists.txt
```
cmake_minimum_required(VERSION 3.20.0)

find_package(Zephyr REQUIRED HINTS $ENV{ZEPHYR_BASE})
project(vuebuds_bridge)

# -Dfw_bridge_USB_TEST=1: USB link test build (src/usb_test.c, host/usb_test.py) instead of the bridge.
zephyr_get(USB_TEST SYSBUILD LOCAL)
if(USB_TEST)
  target_compile_definitions(app PRIVATE USB_TEST)
endif()

target_sources(app PRIVATE src/main.c src/usb.c src/usb_test.c src/central.c)
```

## prj.conf
```kconfig
# Logs: printk to RTT, like fw_nrf5340 (the J-Link VCOM UART stays free).
CONFIG_CONSOLE=y
CONFIG_PRINTK=y
CONFIG_USE_SEGGER_RTT=y
CONFIG_RTT_CONSOLE=y
CONFIG_UART_CONSOLE=n
CONFIG_SEGGER_RTT_BUFFER_SIZE_UP=4096

# Data to the PC: USB CDC ACM on the "nRF USB" connector (full speed, 12 Mbit/s).
CONFIG_SERIAL=y
CONFIG_UART_INTERRUPT_DRIVEN=y
CONFIG_UART_LINE_CTRL=y
CONFIG_USB_DEVICE_STACK_NEXT=y
CONFIG_USBD_CDC_ACM_CLASS=y
CONFIG_CDC_ACM_SERIAL_INITIALIZE_AT_BOOT=y
CONFIG_CDC_ACM_SERIAL_PRODUCT_STRING="VueBuds bridge"
CONFIG_USBD_LOG_LEVEL_ERR=y
CONFIG_UDC_DRIVER_LOG_LEVEL_ERR=y
CONFIG_USBD_CDC_ACM_LOG_LEVEL_OFF=y
CONFIG_LOG=y
CONFIG_LOG_BACKEND_RTT=y
CONFIG_LOG_BACKEND_UART=n

CONFIG_MAIN_STACK_SIZE=4096

# BLE central for the two camera boards (src/central.c).
CONFIG_BT=y
CONFIG_BT_CENTRAL=y
CONFIG_BT_GATT_CLIENT=y
CONFIG_BT_GATT_AUTO_DISCOVER_CCC=y
CONFIG_BT_MAX_CONN=2
CONFIG_BT_DEVICE_NAME="vuebuds-bridge"
# ATT MTU 498, data length 251, 2M PHY (as the camera boards).
CONFIG_BT_L2CAP_TX_MTU=498
CONFIG_BT_BUF_ACL_RX_SIZE=502
CONFIG_BT_BUF_ACL_TX_SIZE=251
CONFIG_BT_CTLR_DATA_LENGTH_MAX=251
CONFIG_BT_CTLR_PHY_2M=y
CONFIG_BT_USER_DATA_LEN_UPDATE=y
CONFIG_BT_USER_PHY_UPDATE=y
CONFIG_BT_AUTO_PHY_UPDATE=n
CONFIG_BT_AUTO_DATA_LEN_UPDATE=n
# Receive side: enough controller and host buffers that a full connection event of
# notifications is acknowledged, not NACKed for lack of a buffer.
CONFIG_BT_CTLR_SDC_RX_PACKET_COUNT=10
CONFIG_BT_BUF_ACL_RX_COUNT_EXTRA=20
CONFIG_BT_BUF_EVT_RX_COUNT=16
# Extend connection events into the free part of the interval (the default); the
# initial reservation per event stays at the default 7.5 ms.
CONFIG_BT_CTLR_SDC_CONN_EVENT_EXTEND_DEFAULT=y
# Link setup (PHY, data length, MTU, discovery) runs on the system work queue.
CONFIG_SYSTEM_WORKQUEUE_STACK_SIZE=2048

# Time sync (src/central.c): connection anchor point reports (HCI VS event).
CONFIG_BT_CTLR_SDC_CONN_ANCHOR_POINT_REPORT=y
CONFIG_BT_HCI_VS_EVT_USER=y
```

## app.overlay
```dts
/* USB CDC ACM serial port to the PC (nRF USB connector). */
&zephyr_udc0 {
	cdc_acm_uart0: cdc_acm_uart0 {
		compatible = "zephyr,cdc-acm-uart";
		label = "VueBuds bridge";
	};
};
```

## src/main.c
```c
/*
 * VueBuds BLE-USB bridge (nRF52840 DK now, nRF5340 DK later): BLE central for the two camera
 * boards, USB CDC ACM to the PC ("nRF USB" connector). Protocol in host/bridge.py.
 *
 * PC -> bridge: [A5 5A][cmd][len u16 LE][payload]
 *   'I'  identify                                -> FRAME_TEXT "VueBuds bridge v1"
 *   'C'  [interval u16 (1.25 ms)][n][n x (type u8, addr 6 B LSB first)]: boards for slots 0..n-1
 *   'W'  [slot mask][bytes]: write the bytes to the control characteristic of those slots
 *   'X'  [slot mask]: disconnect (the boards reboot, the bridge reconnects)
 *   'T'  [slot mask][delay ms u16][camera command]: timed command at one bridge time T for all
 *        (central.h centralTimedWrite; 0xB7 = picture at T)
 * Bridge -> PC: [A5 5A][type][slot][len u16 LE][payload], types in central.h.
 *
 * Build with -Dfw_bridge_USB_TEST=1 for the USB link test instead (src/usb_test.c, host/usb_test.py).
 */
#include <string.h>

#include <zephyr/kernel.h>
#include <zephyr/sys/printk.h>

#include "central.h"
#include "usb.h"

#ifdef USB_TEST
extern void usbTestRun(void);
#endif

#define CMD_MAX 64

static void handle(uint8_t cmd, const uint8_t *p, uint16_t len)
{
  switch (cmd) {
    case 'I': {
      static const char id[] = "VueBuds bridge v1";
      usbSendFrame(FRAME_TEXT, 0xFF, id, sizeof(id) - 1);
      break;
    }
    case 'C': {
      if (len < 3 || p[2] > CENTRAL_SLOTS || len < 3 + 7 * p[2]) {
        break;
      }
      bt_addr_le_t addrs[CENTRAL_SLOTS];
      for (int i = 0; i < p[2]; i++) {
        addrs[i].type = p[3 + 7 * i];
        memcpy(addrs[i].a.val, &p[4 + 7 * i], 6);
      }
      uint16_t interval = p[0] | (p[1] << 8);
      printk("[bridge] configure: %u board(s), interval %u x 1.25 ms\n", p[2], interval);
      centralConfigure(addrs, p[2], interval);
      break;
    }
    case 'W':
      if (len >= 2) {
        centralWrite(p[0], p + 1, len - 1);
      }
      break;
    case 'T':
      if (len >= 4) {
        centralTimedWrite(p[0], p[1] | (p[2] << 8), p[3]);
      }
      break;
    case 'X':
      if (len >= 1) {
        centralDisconnect(p[0]);
      }
      break;
    default:
      printk("[bridge] unknown command 0x%02x\n", cmd);
      break;
  }
}

int main(void)
{
  printk("[bridge] booting\n");
  if (!usbInit()) {
    printk("[bridge] CDC ACM not ready\n");
    return 0;
  }
#ifdef USB_TEST
  usbTestRun();
#endif
  centralInit();

  for (;;) {
    usbWaitHostOpen();
    printk("[bridge] host port open\n");
    while (usbHostOpen()) {
      uint8_t sync;
      if (!usbReadTimeout(&sync, 1, 100) || sync != 0xA5) {
        continue;
      }
      uint8_t h[4];
      if (!usbReadTimeout(h, 1, 100) || h[0] != 0x5A || !usbReadTimeout(h + 1, 3, 100)) {
        continue;
      }
      uint16_t len = h[2] | (h[3] << 8);
      static uint8_t payload[CMD_MAX];
      if (len > CMD_MAX || !usbReadTimeout(payload, len, 100)) {
        printk("[bridge] bad command frame (cmd 0x%02x, len %u)\n", h[1], len);
        continue;
      }
      handle(h[1], payload, len);
    }
    printk("[bridge] host port closed\n");
  }
  return 0;
}
```

## src/central.c
```c
/*
 * BLE central for up to two camera boards. The bridge, not the PC's Bluetooth stack, sets the
 * link: connection interval (from the PC's configure command, the same for both links),
 * 2M PHY, data length 251, ATT MTU 498, and it rejects the boards' own parameter requests
 * (fw_nrf5340 asks for 7.5-15 ms after 5 s). Connection events are extended while there is
 * radio time (CONFIG_BT_CTLR_SDC_CONN_EVENT_EXTEND_DEFAULT), so one link alone gets the whole
 * interval and two links share it.
 *
 * Connects one board at a time (one pending LE create at a time), reconnects after a drop.
 * Every data notification goes to the PC as a FRAME_NOTIFY frame from the BT RX thread; when
 * USB is slower than the radio that thread blocks, the controller runs out of RX buffers and
 * BLE flow control holds the board back (no packet is dropped).
 */
#include <string.h>

#include <zephyr/kernel.h>
#include <zephyr/sys/printk.h>
#include <zephyr/bluetooth/bluetooth.h>
#include <zephyr/bluetooth/conn.h>
#include <zephyr/bluetooth/gatt.h>
#include <zephyr/bluetooth/uuid.h>
#include <zephyr/bluetooth/hci.h>
#include <zephyr/sys/byteorder.h>
#include <bluetooth/hci_vs_sdc.h>

#include "central.h"
#include "usb.h"

#define UUID_BASE(x) BT_UUID_128_ENCODE(0x47ea0000 | (x), 0xa0e4, 0x554e, 0x5282, 0x0afcd3246970)
static const struct bt_uuid_128 dataUuid = BT_UUID_INIT_128(UUID_BASE(0x1402));
static const struct bt_uuid_128 controlUuid = BT_UUID_INIT_128(UUID_BASE(0x1403));

#define CONNECT_TIMEOUT_10MS 300  // give up one connect attempt after 3 s, try the next slot
#define SUPERVISION_TIMEOUT_10MS 400

typedef struct {
  bool used;
  bt_addr_le_t addr;
  struct bt_conn *conn;
  bool connected;
  bool ready;
  uint16_t dataHandle, controlHandle;
  struct bt_gatt_discover_params disc;
  struct bt_gatt_discover_params cccDisc;
  struct bt_gatt_subscribe_params sub;
  struct bt_gatt_exchange_params mtu;
  struct k_work setup;  // PHY, data length, MTU, discovery: off the BT RX thread
  uint32_t packets, bytes;  // notifications since the last stats line
  // Latest connection anchor point on the bridge's controller clock (time sync, plan E).
  bool anchorValid;
  uint64_t anchorUs;
  uint16_t anchorCounter;
} slot_t;

static slot_t slots[CENTRAL_SLOTS];
static uint16_t interval = 12;  // 15 ms until the PC configures it
static bool connecting;
static K_MUTEX_DEFINE(lock);
static struct k_spinlock anchorLock;

#define CMD_TIME_REFERENCE 0xB5  // fw_nrf5340/src/timesync.h
#define REFERENCE_PERIOD_S 5

static void connectNext(struct k_work *work);
static void scheduleReference(void);
static K_WORK_DELAYABLE_DEFINE(connectWork, connectNext);

static void text(int slot, const char *fmt, ...)
{
  char buf[120];
  va_list ap;
  va_start(ap, fmt);
  int n = vsnprintk(buf, sizeof(buf), fmt, ap);
  va_end(ap);
  n = MIN(n, (int)sizeof(buf) - 1);
  printk("[bridge] slot %d: %s\n", slot, buf);
  usbSendFrame(FRAME_TEXT, slot < 0 ? 0xFF : slot, buf, n);
}

static int slotOf(struct bt_conn *conn)
{
  for (int i = 0; i < CENTRAL_SLOTS; i++) {
    if (slots[i].conn == conn) {
      return i;
    }
  }
  return -1;
}

static void sendEvent(int i, uint8_t state, uint8_t reason)
{
  central_event_t ev = {.state = state, .addr_type = slots[i].addr.type, .reason = reason};
  memcpy(ev.addr, slots[i].addr.a.val, 6);
  struct bt_conn_info info;
  if (slots[i].conn && slots[i].connected && bt_conn_get_info(slots[i].conn, &info) == 0) {
    ev.interval_1250us = info.le.interval_us / 1250;
    ev.tx_phy = info.le.phy->tx_phy == BT_GAP_LE_PHY_2M ? 2 : 1;
    ev.rx_phy = info.le.phy->rx_phy == BT_GAP_LE_PHY_2M ? 2 : 1;
    ev.tx_len = info.le.data_len->tx_max_len;
    ev.rx_len = info.le.data_len->rx_max_len;
    ev.mtu = bt_gatt_get_mtu(slots[i].conn);
  }
  usbSendFrame(FRAME_EVENT, i, &ev, sizeof(ev));
}

/* ---- notifications, discovery ---- */

static uint8_t onNotify(struct bt_conn *conn, struct bt_gatt_subscribe_params *params, const void *data,
                        uint16_t length)
{
  slot_t *s = CONTAINER_OF(params, slot_t, sub);
  int i = s - slots;
  if (data == NULL) {
    text(i, "notifications off");
    params->value_handle = 0;
    return BT_GATT_ITER_STOP;
  }
  s->packets++;
  s->bytes += length;
  usbSendFrame(FRAME_NOTIFY, i, data, length);
  return BT_GATT_ITER_CONTINUE;
}

static void subscribe(int i)
{
  slot_t *s = &slots[i];
  if (!s->dataHandle || !s->controlHandle) {
    text(i, "service not found (data 0x%04x, control 0x%04x)", s->dataHandle, s->controlHandle);
    bt_conn_disconnect(s->conn, BT_HCI_ERR_REMOTE_USER_TERM_CONN);
    return;
  }
  memset(&s->sub, 0, sizeof(s->sub));
  s->sub.notify = onNotify;
  s->sub.value = BT_GATT_CCC_NOTIFY;
  s->sub.value_handle = s->dataHandle;
  s->sub.ccc_handle = BT_GATT_AUTO_DISCOVER_CCC_HANDLE;
  s->sub.end_handle = s->controlHandle;  // the data CCC sits between the two characteristics
  s->sub.disc_params = &s->cccDisc;
  int err = bt_gatt_subscribe(s->conn, &s->sub);
  if (err && err != -EALREADY) {
    text(i, "subscribe failed (%d)", err);
    return;
  }
  // Notifications are on once the CCC write is sent; the board starts nothing until a command.
  s->ready = true;
  text(i, "ready: data 0x%04x, control 0x%04x", s->dataHandle, s->controlHandle);
  scheduleReference();
  sendEvent(i, CENTRAL_READY, 0);
}

static uint8_t onDiscover(struct bt_conn *conn, const struct bt_gatt_attr *attr,
                          struct bt_gatt_discover_params *params)
{
  slot_t *s = CONTAINER_OF(params, slot_t, disc);
  if (attr == NULL) {
    subscribe(s - slots);
    return BT_GATT_ITER_STOP;
  }
  const struct bt_gatt_chrc *chrc = attr->user_data;
  if (bt_uuid_cmp(chrc->uuid, &dataUuid.uuid) == 0) {
    s->dataHandle = chrc->value_handle;
  } else if (bt_uuid_cmp(chrc->uuid, &controlUuid.uuid) == 0) {
    s->controlHandle = chrc->value_handle;
  }
  return BT_GATT_ITER_CONTINUE;
}

static void onMtu(struct bt_conn *conn, uint8_t err, struct bt_gatt_exchange_params *params)
{
  int i = slotOf(conn);
  if (i < 0) {
    return;
  }
  text(i, "MTU %u%s", bt_gatt_get_mtu(conn), err ? " (exchange failed)" : "");
  slot_t *s = &slots[i];
  memset(&s->disc, 0, sizeof(s->disc));
  s->disc.func = onDiscover;
  s->disc.start_handle = BT_ATT_FIRST_ATTRIBUTE_HANDLE;
  s->disc.end_handle = BT_ATT_LAST_ATTRIBUTE_HANDLE;
  s->disc.type = BT_GATT_DISCOVER_CHARACTERISTIC;
  int e = bt_gatt_discover(conn, &s->disc);
  if (e) {
    text(i, "discovery failed (%d)", e);
  }
}

/* ---- time sync (plan E, as nrf/samples/bluetooth/conn_time_sync) ---- */

/* Controller anchor point reports: one per connection event and link. */
static bool onVendorEvent(struct net_buf_simple *buf)
{
  uint8_t *code = net_buf_simple_pull_mem(buf, sizeof(*code));
  if (*code != SDC_HCI_SUBEVENT_VS_CONN_ANCHOR_POINT_UPDATE_REPORT) {
    return false;
  }
  const sdc_hci_subevent_vs_conn_anchor_point_update_report_t *evt = (const void *)buf->data;
  struct bt_conn *conn = bt_hci_conn_lookup_handle(evt->conn_handle);
  if (conn == NULL) {
    return true;
  }
  int i = slotOf(conn);
  bt_conn_unref(conn);
  if (i >= 0) {
    k_spinlock_key_t key = k_spin_lock(&anchorLock);
    slots[i].anchorValid = true;
    slots[i].anchorUs = evt->anchor_point_us;
    slots[i].anchorCounter = evt->event_counter;
    k_spin_unlock(&anchorLock, key);
  }
  return true;
}

/* [cmd][anchor us u64][event counter u16] (+ [T u64] for timed commands) */
static int writeTimed(int i, uint8_t cmd, const uint64_t *t_us)
{
  slot_t *s = &slots[i];
  uint8_t msg[19];
  k_spinlock_key_t key = k_spin_lock(&anchorLock);
  bool valid = s->anchorValid;
  msg[0] = cmd;
  sys_put_le64(s->anchorUs, &msg[1]);
  sys_put_le16(s->anchorCounter, &msg[9]);
  k_spin_unlock(&anchorLock, key);
  if (!valid || !s->ready || !s->conn) {
    return -EAGAIN;
  }
  size_t len = 11;
  if (t_us) {
    sys_put_le64(*t_us, &msg[11]);
    len = 19;
  }
  return bt_gatt_write_without_response(s->conn, s->controlHandle, msg, len, false);
}

/* References keep the boards' mapping fresh (event counters wrap after 65536 events). */
static void sendReferences(struct k_work *work);
static K_WORK_DELAYABLE_DEFINE(referenceWork, sendReferences);
static void sendReferences(struct k_work *work)
{
  for (int i = 0; i < CENTRAL_SLOTS; i++) {
    if (slots[i].ready) {
      writeTimed(i, CMD_TIME_REFERENCE, NULL);
    }
  }
  k_work_reschedule(&referenceWork, K_SECONDS(REFERENCE_PERIOD_S));
}

static void scheduleReference(void)
{
  k_work_reschedule(&referenceWork, K_MSEC(200));  // after a couple of anchor reports
}

/* ---- connection management ---- */

static void connectNext(struct k_work *work)
{
  k_mutex_lock(&lock, K_FOREVER);
  if (!connecting) {
    for (int i = 0; i < CENTRAL_SLOTS; i++) {
      slot_t *s = &slots[i];
      if (!s->used || s->conn) {
        continue;
      }
      struct bt_conn_le_create_param create =
          BT_CONN_LE_CREATE_PARAM_INIT(BT_CONN_LE_OPT_NONE, BT_GAP_SCAN_FAST_INTERVAL, BT_GAP_SCAN_FAST_INTERVAL);
      create.timeout = CONNECT_TIMEOUT_10MS;
      struct bt_le_conn_param param = BT_LE_CONN_PARAM_INIT(interval, interval, 0, SUPERVISION_TIMEOUT_10MS);
      int err = bt_conn_le_create(&s->addr, &create, &param, &s->conn);
      if (err) {
        s->conn = NULL;
        text(i, "connect failed to start (%d)", err);
        k_work_reschedule(&connectWork, K_MSEC(500));
      } else {
        connecting = true;
      }
      break;
    }
  }
  k_mutex_unlock(&lock);
}

static void connected(struct bt_conn *conn, uint8_t err)
{
  k_mutex_lock(&lock, K_FOREVER);
  int i = slotOf(conn);
  connecting = false;
  if (i < 0) {
    k_mutex_unlock(&lock);
    return;
  }
  slot_t *s = &slots[i];
  if (err) {
    // 0x02 (unknown connection id): the 3 s attempt timed out; the board is off or busy.
    bt_conn_unref(s->conn);
    s->conn = NULL;
    k_mutex_unlock(&lock);
    k_work_reschedule(&connectWork, K_MSEC(100));
    return;
  }
  s->connected = true;
  s->dataHandle = s->controlHandle = 0;
  k_mutex_unlock(&lock);

  char addr[BT_ADDR_LE_STR_LEN];
  bt_addr_le_to_str(&s->addr, addr, sizeof(addr));
  text(i, "connected %s", addr);
  sendEvent(i, CENTRAL_CONNECTED, 0);

  // These wait for HCI command completions, which the BT RX thread (running this callback)
  // delivers: calling them here deadlocks ("Controller unresponsive" assert).
  k_work_submit(&s->setup);
}

static void setupLink(struct k_work *work)
{
  slot_t *s = CONTAINER_OF(work, slot_t, setup);
  struct bt_conn *conn = s->conn;
  if (!conn || !s->connected) {
    return;
  }
  int i = s - slots;
  int err = bt_conn_le_phy_update(conn, BT_CONN_LE_PHY_PARAM_2M);
  if (err) {
    text(i, "PHY update failed (%d)", err);
  }
  err = bt_conn_le_data_len_update(conn, BT_LE_DATA_LEN_PARAM_MAX);
  if (err) {
    text(i, "data length update failed (%d)", err);
  }
  s->mtu.func = onMtu;
  if (bt_gatt_exchange_mtu(conn, &s->mtu) != 0) {
    onMtu(conn, 0, &s->mtu);  // the board already exchanged it
  }
  k_work_reschedule(&connectWork, K_NO_WAIT);  // next slot
}

static void disconnected(struct bt_conn *conn, uint8_t reason)
{
  k_mutex_lock(&lock, K_FOREVER);
  int i = slotOf(conn);
  if (i < 0) {
    k_mutex_unlock(&lock);
    return;
  }
  slot_t *s = &slots[i];
  s->connected = false;
  s->ready = false;
  bt_conn_unref(s->conn);
  s->conn = NULL;
  k_mutex_unlock(&lock);
  text(i, "disconnected (0x%02x)", reason);
  sendEvent(i, CENTRAL_DISCONNECTED, reason);
  k_work_reschedule(&connectWork, K_MSEC(300));  // the board reboots on disconnect (~1 s)
}

static bool paramRequest(struct bt_conn *conn, struct bt_le_conn_param *param)
{
  int i = slotOf(conn);
  if (param->interval_min <= interval && interval <= param->interval_max) {
    param->interval_min = param->interval_max = interval;  // keep ours
    return true;
  }
  text(i, "rejected parameter request %u-%u (keeping %u)", param->interval_min, param->interval_max, interval);
  return false;
}

static void paramUpdated(struct bt_conn *conn, uint16_t itv, uint16_t latency, uint16_t timeout)
{
  int i = slotOf(conn);
  if (i >= 0) {
    text(i, "interval %u.%02u ms, latency %u", itv * 125 / 100, (itv * 125) % 100, latency);
    sendEvent(i, CENTRAL_UPDATED, 0);
  }
}

static void phyUpdated(struct bt_conn *conn, struct bt_conn_le_phy_info *phy)
{
  int i = slotOf(conn);
  if (i >= 0) {
    text(i, "PHY tx %u rx %u", phy->tx_phy, phy->rx_phy);
    sendEvent(i, CENTRAL_UPDATED, 0);
  }
}

static void dataLenUpdated(struct bt_conn *conn, struct bt_conn_le_data_len_info *info)
{
  int i = slotOf(conn);
  if (i >= 0) {
    text(i, "data length tx %u rx %u", info->tx_max_len, info->rx_max_len);
    sendEvent(i, CENTRAL_UPDATED, 0);
  }
}

BT_CONN_CB_DEFINE(connCallbacks) = {
  .connected = connected,
  .disconnected = disconnected,
  .le_param_req = paramRequest,
  .le_param_updated = paramUpdated,
  .le_phy_updated = phyUpdated,
  .le_data_len_updated = dataLenUpdated,
};

/* RTT only: notifications per second per slot; CPU load with -Dfw_bridge_CONFIG_SCHED_THREAD_USAGE_ALL=y
 * -Dfw_bridge_CONFIG_THREAD_RUNTIME_STATS=y (excludes the controller's zero-latency interrupts). */
static void stats(struct k_work *work);
static K_WORK_DELAYABLE_DEFINE(statsWork, stats);
static void stats(struct k_work *work)
{
#ifdef CONFIG_SCHED_THREAD_USAGE_ALL
  static uint64_t lastAll, lastIdle;
  k_thread_runtime_stats_t all;
  k_thread_runtime_stats_all_get(&all);
  uint64_t dAll = all.total_cycles - lastAll, dIdle = all.idle_cycles - lastIdle;
  lastAll = all.total_cycles;
  lastIdle = all.idle_cycles;
  if (dAll + dIdle) {
    printk("[bridge] CPU busy %u%%\n", (uint32_t)(100 * dAll / (dAll + dIdle)));
  }
#endif
  for (int i = 0; i < CENTRAL_SLOTS; i++) {
    if (slots[i].packets) {
      printk("[bridge] slot %d: %u packets/s, %u KB/s\n", i, slots[i].packets, slots[i].bytes / 1024);
      slots[i].packets = slots[i].bytes = 0;
    }
  }
  k_work_reschedule(&statsWork, K_SECONDS(1));
}

/* ---- API ---- */

void centralInit(void)
{
  for (int i = 0; i < CENTRAL_SLOTS; i++) {
    k_work_init(&slots[i].setup, setupLink);
  }
  int err = bt_enable(NULL);
  printk("[bridge] Bluetooth %s (%d)\n", err ? "failed" : "on", err);
  bt_hci_register_vnd_evt_cb(onVendorEvent);
  sdc_hci_cmd_vs_conn_anchor_point_update_event_report_enable_t enable = {.enable = true};
  err = hci_vs_sdc_conn_anchor_point_update_event_report_enable(&enable);
  printk("[bridge] anchor point reports %s (%d)\n", err ? "failed" : "on", err);
  k_work_reschedule(&statsWork, K_SECONDS(1));
}

void centralConfigure(const bt_addr_le_t *addrs, uint8_t count, uint16_t interval_1250us)
{
  k_mutex_lock(&lock, K_FOREVER);
  bool changed = interval_1250us && interval_1250us != interval;
  if (interval_1250us) {
    interval = interval_1250us;
  }
  for (int i = 0; i < CENTRAL_SLOTS; i++) {
    slot_t *s = &slots[i];
    bool want = i < count;
    if (want && s->used && bt_addr_le_eq(&s->addr, &addrs[i])) {
      if (changed && s->conn && s->connected) {
        struct bt_le_conn_param p = BT_LE_CONN_PARAM_INIT(interval, interval, 0, SUPERVISION_TIMEOUT_10MS);
        bt_conn_le_param_update(s->conn, &p);
      }
      // Kept link: tell the (possibly new) PC session where it stands.
      if (s->connected) {
        sendEvent(i, s->ready ? CENTRAL_READY : CENTRAL_CONNECTED, 0);
      }
      continue;
    }
    if (s->conn) {
      bt_conn_disconnect(s->conn, BT_HCI_ERR_REMOTE_USER_TERM_CONN);  // slot freed in disconnected()
    }
    s->used = want;
    if (want) {
      bt_addr_le_copy(&s->addr, &addrs[i]);
    }
  }
  k_mutex_unlock(&lock);
  k_work_reschedule(&connectWork, K_NO_WAIT);
}

void centralWrite(uint8_t mask, const uint8_t *data, uint16_t len)
{
  // Back to back: each write goes out at its own link's next connection event.
  for (int i = 0; i < CENTRAL_SLOTS; i++) {
    if (!(mask & BIT(i))) {
      continue;
    }
    slot_t *s = &slots[i];
    int8_t err = -ENOTCONN;
    if (s->conn && s->connected && s->controlHandle) {
      err = bt_gatt_write_without_response(s->conn, s->controlHandle, data, len, false);
    }
    usbSendFrame(FRAME_WRITE, i, &err, 1);
  }
}

void centralTimedWrite(uint8_t mask, uint16_t delay_ms, uint8_t cmd)
{
  // One bridge time T for every link: the newest anchor point plus the delay.
  uint64_t base = 0;
  k_spinlock_key_t key = k_spin_lock(&anchorLock);
  for (int i = 0; i < CENTRAL_SLOTS; i++) {
    if ((mask & BIT(i)) && slots[i].anchorValid) {
      base = MAX(base, slots[i].anchorUs);
    }
  }
  k_spin_unlock(&anchorLock, key);
  uint64_t t_us = base + (uint64_t)delay_ms * 1000;
  for (int i = 0; i < CENTRAL_SLOTS; i++) {
    if (mask & BIT(i)) {
      int8_t err = base ? writeTimed(i, cmd, &t_us) : -EAGAIN;
      usbSendFrame(FRAME_WRITE, i, &err, 1);
    }
  }
  text(-1, "timed 0x%02x at %u.%03u ms (bridge clock)", cmd, (uint32_t)(t_us / 1000), (uint32_t)(t_us % 1000));
}

void centralDisconnect(uint8_t mask)
{
  for (int i = 0; i < CENTRAL_SLOTS; i++) {
    if ((mask & BIT(i)) && slots[i].conn) {
      bt_conn_disconnect(slots[i].conn, BT_HCI_ERR_REMOTE_USER_TERM_CONN);
    }
  }
}
```

## src/central.h
```c
/* BLE central: up to two "mustard" camera boards (fw_nrf5340/src/ble.c protocol). */
#ifndef CENTRAL_H_
#define CENTRAL_H_

#include <stdint.h>
#include <zephyr/bluetooth/addr.h>

#define CENTRAL_SLOTS 2

/* Bridge -> PC frame types (usbSendFrame) */
#define FRAME_NOTIFY 'N'  // payload: one data notification ([seq, flags, ...])
#define FRAME_EVENT  'E'  // payload: central_event_t
#define FRAME_TEXT   'S'  // payload: log text
#define FRAME_WRITE  'W'  // payload: int8 result of a control write (0 = queued)

enum {
  CENTRAL_DISCONNECTED = 0,
  CENTRAL_CONNECTED = 1,
  CENTRAL_READY = 2,    // notifications on, control handle known
  CENTRAL_UPDATED = 3,  // connection parameters / PHY / data length changed
};

typedef struct __packed {
  uint8_t state;
  uint8_t addr_type;
  uint8_t addr[6];          // LSB first, as bt_addr_t
  uint16_t interval_1250us;
  uint8_t tx_phy, rx_phy;   // 1 = 1M, 2 = 2M
  uint16_t tx_len, rx_len;  // data length
  uint16_t mtu;
  uint8_t reason;           // HCI reason on disconnect
} central_event_t;

void centralInit(void);
/* Connect to these boards (slot i = addrs[i]); slots whose address did not change keep their link. */
void centralConfigure(const bt_addr_le_t *addrs, uint8_t count, uint16_t interval_1250us);
/* Write without response to the control characteristic of every ready slot in mask. */
void centralWrite(uint8_t mask, const uint8_t *data, uint16_t len);
/* Drop the links in mask; they reconnect by themselves (the camera reboots on disconnect). */
void centralDisconnect(uint8_t mask);
/* Time sync: write [cmd][this link's anchor u64][counter u16][T u64] to every ready slot in mask,
 * T = the newest anchor point + delay_ms (the same T for all), e.g. cmd 0xB7 = picture at T. */
void centralTimedWrite(uint8_t mask, uint16_t delay_ms, uint8_t cmd);

#endif
```

## src/usb.c
```c
/*
 * USB CDC ACM, interrupt driven, through two ring buffers. Zephyr's CDC ACM class sends
 * one 64-byte USB transfer at a time: about 212 KB/s to the PC (host/usb_test.py), above
 * what two BLE links deliver together (~170 KB/s at most).
 */
#include <zephyr/kernel.h>
#include <zephyr/device.h>
#include <zephyr/drivers/uart.h>
#include <zephyr/sys/ring_buffer.h>

#include "usb.h"

static const struct device *const cdc = DEVICE_DT_GET(DT_NODELABEL(cdc_acm_uart0));

RING_BUF_DECLARE(rxRing, 4096);
RING_BUF_DECLARE(txRing, 16384);
static K_SEM_DEFINE(rxReady, 0, 1);
static K_SEM_DEFINE(txSpace, 0, 1);
static K_MUTEX_DEFINE(txLock);  // one frame at a time (BT RX thread and main thread both send)

static void cdcIrq(const struct device *dev, void *user_data)
{
  ARG_UNUSED(user_data);
  while (uart_irq_update(dev) && uart_irq_is_pending(dev)) {
    if (uart_irq_rx_ready(dev)) {
      uint8_t *p;
      uint32_t room = ring_buf_put_claim(&rxRing, &p, 512);
      if (room == 0) {
        uart_irq_rx_disable(dev);  // re-enabled by the reader
      } else {
        int n = uart_fifo_read(dev, p, room);
        ring_buf_put_finish(&rxRing, n > 0 ? n : 0);
      }
      k_sem_give(&rxReady);
    }
    if (uart_irq_tx_ready(dev)) {
      uint8_t *p;
      uint32_t avail = ring_buf_get_claim(&txRing, &p, 512);
      if (avail == 0) {
        ring_buf_get_finish(&txRing, 0);
        uart_irq_tx_disable(dev);
      } else {
        int n = uart_fifo_fill(dev, p, avail);
        ring_buf_get_finish(&txRing, n > 0 ? n : 0);
      }
      k_sem_give(&txSpace);
    }
  }
}

bool usbInit(void)
{
  if (!device_is_ready(cdc)) {
    return false;
  }
  uart_irq_callback_set(cdc, cdcIrq);
  return true;
}

bool usbHostOpen(void)
{
  uint32_t dtr = 0;
  return uart_line_ctrl_get(cdc, UART_LINE_CTRL_DTR, &dtr) == 0 && dtr;
}

void usbWaitHostOpen(void)
{
  while (!usbHostOpen()) {
    k_msleep(50);
  }
  uart_irq_rx_enable(cdc);
}

bool usbReadTimeout(void *buf, uint32_t len, int32_t timeout_ms)
{
  uint8_t *dst = buf;
  int64_t deadline = k_uptime_get() + timeout_ms;
  while (len > 0) {
    uint32_t n = ring_buf_get(&rxRing, dst, len);
    dst += n;
    len -= n;
    if (len > 0) {
      if (timeout_ms >= 0 && k_uptime_get() >= deadline) {
        return false;
      }
      uart_irq_rx_enable(cdc);
      k_sem_take(&rxReady, K_MSEC(10));
    }
  }
  return true;
}

void usbRead(void *buf, uint32_t len)
{
  usbReadTimeout(buf, len, -1);
}

static void writeLocked(const void *buf, uint32_t len)
{
  const uint8_t *src = buf;
  while (len > 0) {
    uint32_t n = ring_buf_put(&txRing, src, len);
    src += n;
    len -= n;
    uart_irq_tx_enable(cdc);
    if (len > 0) {
      if (!usbHostOpen()) {
        ring_buf_reset(&txRing);  // nobody reads: drop instead of blocking the BLE side forever
        return;
      }
      k_sem_take(&txSpace, K_MSEC(10));
    }
  }
}

void usbWrite(const void *buf, uint32_t len)
{
  k_mutex_lock(&txLock, K_FOREVER);
  writeLocked(buf, len);
  k_mutex_unlock(&txLock);
}

void usbSendFrame(uint8_t type, uint8_t slot, const void *payload, uint16_t len)
{
  uint8_t header[6] = {0xA5, 0x5A, type, slot, len & 0xFF, len >> 8};
  k_mutex_lock(&txLock, K_FOREVER);
  writeLocked(header, sizeof(header));
  writeLocked(payload, len);
  k_mutex_unlock(&txLock);
}
```

## src/usb.h
```c
/* USB CDC ACM link to the PC (the DK's "nRF USB" connector). */
#ifndef USB_H_
#define USB_H_

#include <stdbool.h>
#include <stdint.h>

bool usbInit(void);
bool usbHostOpen(void);              // the PC has the port open (DTR)
void usbWaitHostOpen(void);
void usbRead(void *buf, uint32_t len);  // blocks until len bytes arrived
bool usbReadTimeout(void *buf, uint32_t len, int32_t timeout_ms);
void usbWrite(const void *buf, uint32_t len);  // blocks while the TX ring is full

/* Bridge frames to the PC: [A5 5A][type][slot][len u16 LE][payload]. Thread-safe. */
void usbSendFrame(uint8_t type, uint8_t slot, const void *payload, uint16_t len);

#endif
```

## src/usb_test.c
```c
/*
 * USB link test (build with -Dfw_bridge_USB_TEST=1, host/usb_test.py). Raw commands, little-endian:
 *   'I'                 -> "VueBuds bridge\n"
 *   'T' <u32 n>         -> n bytes of u32 counter words 0, 1, 2, ..., then 'D' <u32 device ms>
 *   'R' <u32 n> <n B>   -> the bridge checks the pattern, then 'r' <u32 bad words> <u32 device ms>
 */
#ifdef USB_TEST

#include <zephyr/kernel.h>
#include <zephyr/sys/printk.h>

#include "usb.h"

static uint32_t readU32(void)
{
  uint32_t v;
  usbRead(&v, sizeof(v));
  return v;
}

static void sendPattern(uint32_t bytes)
{
  static uint32_t words[256];
  uint32_t counter = 0;
  int64_t t0 = k_uptime_get();
  while (bytes > 0) {
    uint32_t chunk = MIN(bytes, sizeof(words));
    for (uint32_t i = 0; i < chunk / 4; i++) {
      words[i] = counter++;
    }
    usbWrite(words, chunk);
    bytes -= chunk;
  }
  uint32_t ms = (uint32_t)(k_uptime_get() - t0);
  uint8_t done = 'D';
  usbWrite(&done, 1);
  usbWrite(&ms, sizeof(ms));
  printk("[usb] sent pattern, %u ms\n", ms);
}

static void checkPattern(uint32_t bytes)
{
  static uint32_t words[256];
  uint32_t counter = 0, bad = 0;
  int64_t t0 = k_uptime_get();
  while (bytes > 0) {
    uint32_t chunk = MIN(bytes, sizeof(words));
    usbRead(words, chunk);
    for (uint32_t i = 0; i < chunk / 4; i++) {
      if (words[i] != counter++) {
        bad++;
      }
    }
    bytes -= chunk;
  }
  uint32_t ms = (uint32_t)(k_uptime_get() - t0);
  uint8_t reply = 'r';
  usbWrite(&reply, 1);
  usbWrite(&bad, sizeof(bad));
  usbWrite(&ms, sizeof(ms));
  printk("[usb] received pattern, %u bad words, %u ms\n", bad, ms);
}

void usbTestRun(void)
{
  for (;;) {
    usbWaitHostOpen();
    printk("[usb] host port open\n");
    while (usbHostOpen()) {
      uint8_t cmd;
      if (!usbReadTimeout(&cmd, 1, 100)) {
        continue;
      }
      switch (cmd) {
        case 'I': {
          static const char id[] = "VueBuds bridge\n";
          usbWrite(id, sizeof(id) - 1);
          break;
        }
        case 'T':
          sendPattern(readU32() & ~3u);
          break;
        case 'R':
          checkPattern(readU32() & ~3u);
          break;
        default:
          printk("[usb] unknown command 0x%02x\n", cmd);
          break;
      }
    }
    printk("[usb] host port closed\n");
  }
}

#endif /* USB_TEST */
```
